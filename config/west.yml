## config/west.yml
```yaml
# manifest:
#   remotes:
#     - name: zmkfirmware
#       url-base: https://github.com/petejohanson
#     - name: inorichi
#       url-base: https://github.com/inorichi
#   projects:
#     - name: zmk
#       remote: zmkfirmware
#       revision: feat/pointers-move-scroll
#       import: app/west.yml
#     - name: zmk-pmw3610-driver
#       remote: inorichi
#       revision: main
#   self:
#     path: config

#defaultの設定
manifest:
  remotes:
    - name: zmkfirmware
      url-base: https://github.com/zmkfirmware
    - name: badjeff
      url-base: https://github.com/badjeff
    - name: caksoylar
      url-base: https://github.com/caksoylar
    - name: carrefinho
      url-base: https://github.com/carrefinho
  projects:
    - name: zmk
      remote: zmkfirmware
      revision: main
      import: app/west.yml
    - name: zmk-pmw3610-driver
      remote: badjeff
      revision: main
    - name: zmk-rgbled-widget
      remote: caksoylar
      revision: main
    - name: prospector-zmk-module
      remote: carrefinho 
      revision: feat/new-status-screens   
  self:
    path: config

  # manifest:
  # remotes:
  #   - name: ImSota
  #     url-base: https://github.com/ImSota
  #   - name: inorichi
  #     url-base: https://github.com/inorichi
  #   - name: caksoylar
  #     url-base: https://github.com/caksoylar
  # projects:
  #   - name: zmk
  #     remote: ImSota
  #     revision: main
  #     import: app/west.yml
  #   - name: zmk-pmw3610-driver
  #     remote: inorichi
  #     revision: main
  #   - name: zmk-rgbled-widget
  #     remote: caksoylar
  #     revision: main
  # self:
  #   path: config
```
